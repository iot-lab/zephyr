&ext1_spi {
	status = "okay";
	label = "SPI_RF2XX";

        /* CS */
	cs-gpios = <&gpioa 4 GPIO_ACTIVE_LOW>;

	rf2xx@0 {
		compatible = "atmel,rf2xx";
		reg = <0x0>;
		label = "RF2XX_0";
		spi-max-frequency = <6000000>;
		irq-gpios = <&gpioc 4
			     (GPIO_PULL_DOWN | GPIO_ACTIVE_HIGH)>;
		reset-gpios = <&gpioc 1 GPIO_ACTIVE_LOW>;
		slptr-gpios = <&gpioa 2 GPIO_ACTIVE_HIGH>;
		status = "okay";
	};
};
