## boards/arm/iotlab_m3/Kconfig.board
```kconfig
# IoT-LAB M3 board configuration

config BOARD_IOTLAB_M3
	bool "IoT-LAB M3 Board"
	depends on SOC_STM32F103XE
```

## boards/arm/iotlab_m3/Kconfig.defconfig
```kconfig
# IoT-LAB M3 board configuration

if BOARD_IOTLAB_M3

config BOARD
	default "iotlab_m3"

endif # BOARD_IOTLAB_M3
```

## boards/arm/iotlab_m3/iotlab_m3_defconfig
```kconfig
CONFIG_SOC_SERIES_STM32F1X=y
CONFIG_SOC_STM32F103XE=y

# enable uart driver
CONFIG_SERIAL=y
# enable console
CONFIG_CONSOLE=y
CONFIG_UART_CONSOLE=y

# enable pinmux
CONFIG_PINMUX=y

# enable GPIO
CONFIG_GPIO=y
# enable SPI
CONFIG_SPI=y

# enable clocks
CONFIG_CLOCK_CONTROL=y
```
